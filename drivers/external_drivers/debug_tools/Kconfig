## drivers/external_drivers/debug_tools/Kconfig
```kconfig
config APWR
	tristate "APWR 3 1"
	---help---
	  Help message of build_kernel_module

config SOCWATCH
	tristate "SOCWATCH 5 1"
	---help---
	  Help message of build_kernel_module

config SEP3_15
	tristate "Enable SEP3_15"
	---help---
	  Help message of build_kernel_module

config PAX
	tristate "PAX"
	---help---
	  Help message of build_kernel_module

config VTSSP
	tristate "vtsspp"
	---help---
	  Help message of build_kernel_module
```
